## configs/t113-s3_defconfig
```kconfig
CONFIG_ARM=y
CONFIG_ARCH_SUNXI=y
CONFIG_DEFAULT_DEVICE_TREE="sun8i-v3s-licheepi-zero"
CONFIG_SPL=y
CONFIG_MACH_SUN8I_T113=y
CONFIG_DRAM_CLK=360

CONFIG_SPL_TEXT_BASE=0x20060
CONFIG_SPL_STACK=0x28000
```

## configs/t113_defconfig
```kconfig
CONFIG_ARM=y
CONFIG_ARCH_SUNXI=y
CONFIG_DEFAULT_DEVICE_TREE="sun8i-t113-mangopi-dual"
CONFIG_SPL=y
CONFIG_MACH_SUN8I_T113=y
CONFIG_DRAM_CLK=360

CONFIG_SPL_TEXT_BASE=0x20060
CONFIG_SPL_STACK=0x28000
CONFIG_SPL_STACK_R_ADDR=0x48000000
CONFIG_SPL_SPI_SUNXI=y

CONFIG_SPL_MMC=y

CONFIG_SUNXI_GPIO_V2=y
```
